#include "lcd12864.h"
#include "system.h"
#include "common.h"
#include "gpio_defs.h"
#include <string.h>
#include <math.h>
#include <stdlib.h>

u8 code g_ascii_table_8x16[95][16] =
{
	// 粗体8x16 点阵的ASCII 码的点阵数据，从"JLX-GB2312"型号的字库IC 中读出来的国标的。
	0x00,0x00,0x00,0x00, 0x00,0x00,0x00,0x00, 0x00,0x00,0x00,0x00, 0x00,0x00,0x00,0x00, //- -(即“空格”）ASCII 码：0X20
	0x00,0x00,0x38,0xFC, 0xFC,0x38,0x00,0x00, 0x00,0x00,0x00,0x0D, 0x0D,0x00,0x00,0x00, //-!- ASCII 码：0X21
	0x00,0x0E,0x1E,0x00, 0x00,0x1E,0x0E,0x00, 0x00,0x00,0x00,0x00, 0x00,0x00,0x00,0x00, //-"-
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	0x08,0x0C,0x04,0x0C, 0x08,0x0C,0x04,0x00, 0x00,0x00,0x00,0x00, 0x00,0x00,0x00,0x00, //-~- ASCII 码：0X7E
};

u8 code g_ascii_table_5x8[95][5] =
{
	/* 全体ASCII 列表:5x8 点阵 */
	0x00,0x00,0x00,0x00,0x00, //- - //space
	0x00,0x00,0x4f,0x00,0x00, //-!-
	0x00,0x07,0x00,0x07,0x00, //-"-
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	0x04,0x02,0x02,0x02,0x01, //-~-
};

u8 g_lcd12864_write_data[8][128];
u8 g_lcd12864_curr_data[8][128];
u8 g_lcd12864_curr_page;
u8 g_lcd12864_curr_column;
u8 lcd12864_is_auto_update;

void lcd12864_init(void)
{
	SET_GPIO_OUT(LCD12864_RESET_GPIO);
	SET_GPIO_H(LCD12864_RESET_GPIO);

	SET_GPIO_OUT(LCD12864_LED_GPIO);
	SET_GPIO_L(LCD12864_LED_GPIO);

	SET_GPIO_OUT(LCD12864_RS_GPIO);
	SET_GPIO_H(LCD12864_RS_GPIO);

	SET_GPIO_OUT(LCD12864_CS_GPIO);
	SET_GPIO_H(LCD12864_CS_GPIO);

	SET_GPIO_OUT(LCD12864_SCK_GPIO);
	SET_GPIO_L(LCD12864_SCK_GPIO);

	SET_GPIO_OUT(LCD12864_SDA_GPIO);
	SET_GPIO_H(LCD12864_SDA_GPIO);

	lcd12864_init_lcd();
	lcd12864_clear_screen();
}

void lcd12864_init_lcd(void)
{
	/* LCD 模块初始化 */
	lcd12864_reset();                                       // 低电平复位

	lcd12864_send_cmd(LCD12864_SOFT_RESET);                 // 软复位
	lcd12864_delay_ms(5);

	lcd12864_send_cmd(LCD12864_POWER_CTRL_1);               // 升压步聚1
	lcd12864_delay_ms(5);

	lcd12864_send_cmd(LCD12864_POWER_CTRL_2);               // 升压步聚2
	lcd12864_delay_ms(5);

	lcd12864_send_cmd(LCD12864_POWER_CTRL_3);               // 升压步聚3
	lcd12864_delay_ms(5);

	lcd12864_send_cmd(LCD12864_R_FlAT_ADJUST(3));           // 粗调对比度，可设置范围0x20～0x27
	lcd12864_send_cmd(LCD12864_R_FINE_ADJUST);              // 微调对比度
	lcd12864_send_cmd(0x28);                                // 0x1a,微调对比度的值，可设置范围0x00～0x3f
	lcd12864_send_cmd(LCD12864_BIAS_NORMAL);                // 1/9 偏压比（bias）
	lcd12864_send_cmd(LCD12864_ADC_NORMAL);                 // 行扫描顺序：从上到下
	lcd12864_send_cmd(LCD12864_OUTPUT_NORMAL);              // 列扫描顺序：从左到右
	lcd12864_send_cmd(LCD12864_START_LINE(0));              // 起始行：第一行开始
	lcd12864_send_cmd(LCD12864_DISP_ON);

	g_lcd12864_curr_page   = 0;
	g_lcd12864_curr_column = 0;
	memset(g_lcd12864_curr_data , 0, sizeof(g_lcd12864_curr_data));
	memset(g_lcd12864_write_data , 0, sizeof(g_lcd12864_write_data));

	lcd12864_is_auto_update = 0;
}

void lcd12864_delay(void)
{
//	system_delay_1us(1);
}

void lcd12864_delay_ms(u32 ms)
{
	system_delay_ms(ms);
}

void lcd12864_send_cmd(u8 dat8)
{
	u8 i;

	SET_GPIO_L(LCD12864_CS_GPIO);
	SET_GPIO_L(LCD12864_RS_GPIO);
	lcd12864_delay();

	for(i=0; i<8; i++)
	{
		SET_GPIO_L(LCD12864_SCK_GPIO);

		if(dat8 & 0x80)
			SET_GPIO_H(LCD12864_SDA_GPIO);
		else
			SET_GPIO_L(LCD12864_SDA_GPIO);

		dat8 <<= 1;

		lcd12864_delay();
		SET_GPIO_H(LCD12864_SCK_GPIO);
		lcd12864_delay();
	}

	SET_GPIO_H(LCD12864_CS_GPIO);
	lcd12864_delay();
}

void lcd12864_send_data(u8 dat8)
{
	u8 i;

	g_lcd12864_curr_data[g_lcd12864_curr_page][g_lcd12864_curr_column] = dat8;
	g_lcd12864_curr_column++;

	SET_GPIO_L(LCD12864_CS_GPIO);
	SET_GPIO_H(LCD12864_RS_GPIO);
	lcd12864_delay();
	
	for(i=0; i<8; i++)
	{
		SET_GPIO_L(LCD12864_SCK_GPIO);
	
		if(dat8 & 0x80)
			SET_GPIO_H(LCD12864_SDA_GPIO);
		else
			SET_GPIO_L(LCD12864_SDA_GPIO);
	
		dat8 <<= 1;
	
		lcd12864_delay();
		SET_GPIO_H(LCD12864_SCK_GPIO);
		lcd12864_delay();
	}
	
	SET_GPIO_H(LCD12864_CS_GPIO);
	lcd12864_delay();
}

u8 lcd12864_read_data(u8 page, u8 column)
{
	return g_lcd12864_curr_data[g_lcd12864_curr_page][g_lcd12864_curr_column];
}

void lcd12864_led_on(void)
{
	SET_GPIO_H(LCD12864_LED_GPIO);
	lcd12864_delay_ms(1);
}

void lcd12864_led_off(void)
{
	SET_GPIO_L(LCD12864_LED_GPIO);
	lcd12864_delay_ms(1);
}

void lcd12864_reset(void)
{
	SET_GPIO_H(LCD12864_RESET_GPIO);
	lcd12864_delay_ms(20);

	SET_GPIO_L(LCD12864_RESET_GPIO);
	lcd12864_delay_ms(100);

	SET_GPIO_H(LCD12864_RESET_GPIO);
	lcd12864_delay_ms(20);
}

void lcd12864_set_address(u8 page, u8 column)
{
	g_lcd12864_curr_page   = page;
	g_lcd12864_curr_column = column;

	lcd12864_send_cmd(LCD12864_PAGE_ADDR(page));
	lcd12864_send_cmd(LCD12864_COL_ADDR_H(column>>4));
	lcd12864_send_cmd(LCD12864_COL_ADDR_L(column));
}

void lcd12864_clear_screen(void)
{
	u8 i, j;

	for(i=0; i<8; i++)
	{
		lcd12864_set_address(i, 0);
		for(j=0; j<128; j++)
		{
			lcd12864_send_data(0x00);
		}
	}
}

void lcd12864_clear_line(u8 page, u8 column, u8 len)
{
	u8 i;

if(lcd12864_is_auto_update)
	lcd12864_update_data(0);

	//lcd12864_set_address(page, column);

	for(i=0; i<len; i++)
	{
		//lcd12864_send_data(0x00);
		g_lcd12864_write_data[page][column+i] = 0x00;
	}

if(lcd12864_is_auto_update)
	lcd12864_update_data(1);
}

void lcd12864_full_display(void)
{
	u8 i, j;

	for(i=0; i<8; i++)
	{
		lcd12864_set_address(i, 0);
		for(j=0; j<128; j++)
		{
			lcd12864_send_data(0xFF);
		}
	}
}

void lcd12864_display_graphic_symbol(u8 page, u8 column, const u8 *p_data, u8 len)
{
	u8 i;

	if(lcd12864_is_auto_update)
		lcd12864_update_data(0);

	//lcd12864_set_address(page, column);
	
	for(i=0; i<len; i++)
	{
		//lcd12864_send_data(p_data[i]);
		g_lcd12864_write_data[page][i+column] = p_data[i];
	}

	if(lcd12864_is_auto_update)
		lcd12864_update_data(1);
}

/*显示32x32 点阵图像、汉字、生僻字或32x32 点阵的其他图标*/
void lcd12864_display_graphic_32x32(u8 page, u8 column, const u8 *dp)
{
	u8 i, j;

	if(lcd12864_is_auto_update)
		lcd12864_update_data(0);

	for(j=0; j<4; j++)
	{
		//lcd12864_set_address(page+j, column);

		for(i=0; i<32; i++, dp++)
		{
			/*写数据到LCD,每写完一个8 位的数据后列地址自动加1*/
			//lcd12864_send_data(*dp);
			g_lcd12864_write_data[page+j][i+column] = *dp;
		}
	}

	if(lcd12864_is_auto_update)
		lcd12864_update_data(1);
}

/*显示16x16 点阵图像、汉字、生僻字或16x16 点阵的其他图标*/
void lcd12864_display_graphic_16x16(u8 page, u8 column, const u8 *dp)
{
	u8 i, j;

	if(lcd12864_is_auto_update)
		lcd12864_update_data(0);

	for(j=0; j<2; j++)
	{
		//lcd12864_set_address(page+j, column);

		for(i=0; i<16; i++, dp++)
		{
			/*写数据到LCD,每写完一个8 位的数据后列地址自动加1*/
			//lcd12864_send_data(*dp);
			g_lcd12864_write_data[page+j][i+column] = *dp;
		}
	}

	if(lcd12864_is_auto_update)
		lcd12864_update_data(1);
}

/*显示8x16 点阵图像、ASCII, 或8x16 点阵的自造字符、其他图标*/
void lcd12864_display_graphic_8x16(u8 page, u8 column, const u8 *dp)
{
	u8 i, j;

	if(lcd12864_is_auto_update)
		lcd12864_update_data(0);

	for(j=0; j<2; j++)
	{
		//lcd12864_set_address(page+j, column);

		for(i=0; i<8; i++, dp++)
		{
			/*写数据到LCD,每写完一个8 位的数据后列地址自动加1*/
			//lcd12864_send_data(*dp);
			g_lcd12864_write_data[page+j][i+column] = *dp;
		}
	}

	if(lcd12864_is_auto_update)
		lcd12864_update_data(1);
}

void lcd12864_display_string_8x16(u8 page, u8 column, const u8 *text)
{
	u8 i=0, j, k, n;

	if(lcd12864_is_auto_update)
		lcd12864_update_data(0);

	while(text[i]>0x00)
	{
		if( (text[i]>=0x20) && (text[i]<=0x7e) )
		{
			j = text[i]-0x20;

			for(n=0; n<2; n++)
			{
				//lcd12864_set_address(page+n, column);

				for(k=0; k<8; k++)
				{
					/*显示8x16 的ASCII 字到LCD 上，y 为页地址，x 为列地址，最后为数据*/
					//lcd12864_send_data(g_ascii_table_8x16[j][k+8*n]);
					g_lcd12864_write_data[page+n][k+column] = g_ascii_table_8x16[j][k+8*n];
				}
			}

			column += 8;
		}

		i++;
	}

	if(lcd12864_is_auto_update)
		lcd12864_update_data(1);
}

void lcd12864_display_string_6x8(u8 page, u8 column, const u8 *text)
{
	u8 i=0, j, k;

	if(lcd12864_is_auto_update)
		lcd12864_update_data(0);

	while(text[i]>0x00)
	{
		if( (text[i]>=0x20) && (text[i]<0x7e) )
		{
			j = text[i]-0x20;
		//	lcd12864_set_address(page, column);

			for(k=0; k<5; k++)
			{
				/*显示5x7 的ASCII 字到LCD 上，y 为页地址，x 为列地址，最后为数据*/
			//	lcd12864_send_data(g_ascii_table_5x8[j][k]);
				g_lcd12864_write_data[page][column+k] = g_ascii_table_5x8[j][k];
			}

			//lcd12864_send_data(0x00);
			g_lcd12864_write_data[page][column+k] = 0x00;

			column += 6;
		}

		i++;
	}

	if(lcd12864_is_auto_update)
		lcd12864_update_data(1);
}

void lcd12864_display_logo(void)
{ 
	lcd12864_update_data(0);

	lcd12864_display_string_6x8(2, 6, "NextGenRF Production");
	lcd12864_display_string_6x8(4, 6, "CMOSTEK RF-EB V2.20");
 
	lcd12864_update_data(1);
}

void lcd12864_set_auto_update(u8 is_auto)
{
	lcd12864_is_auto_update = is_auto;
}

void lcd12864_update_data(u8 is_update)
{
	if(is_update)
	{
		u8 i, j;
		for(i=0; i<8; i++)
		{
			for(j=0; j<128; j++)
			{
				if(g_lcd12864_write_data[i][j] != g_lcd12864_curr_data[i][j])
				{
					lcd12864_set_address(i, j);
					lcd12864_send_data(g_lcd12864_write_data[i][j]);
				}
			}
		}
	}
	else
	{
		memcpy(g_lcd12864_write_data, g_lcd12864_curr_data, sizeof(g_lcd12864_curr_data));
	}
}

void lcd12864_draw_point_to_buf(u8 x, u8 y)
{
	u8 page = y / 8;
	u8 mask = 0x01 << (y % 8);
	u8 data8;

	data8  = g_lcd12864_write_data[page][x];
	data8 &= ~mask;
	data8 |= mask;

	g_lcd12864_write_data[page][x] = data8;
}

void lcd12864_draw_point(u8 x, u8 y)
{ 
 	lcd12864_draw_point_to_buf(x, y); 
}

void lcd12864_draw_line(u8 x1, u8 y1, u8 x2, u8 y2)
{
	long i, j;
	long width, height;
	long stepx, stepy;

	width  = (long)x2 - (long)x1 + 1;
	height = (long)y2 - (long)y1 + 1;
	stepx  = width>0 ?1 :-1;
	stepy  = height>0 ?1 :-1; 

	for(i = x1; i-stepx != x2; i += stepx)
	{
		if(abs(height/width)==1)
			j = y1 + stepy*abs(i-x1);
		else
			j = y1 + stepy*abs(((i-x1)*height)/width);

		lcd12864_draw_point_to_buf(i, j); 
	}
}


